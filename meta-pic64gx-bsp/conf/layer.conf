## meta-pic64gx-bsp/conf/layer.conf
```bitbake
# We have a conf and classes directory, add to BBPATH
BBPATH .= ":${LAYERDIR}"

# We have recipes-* directories, add to BBFILES
BBFILES += "${LAYERDIR}/recipes-*/*/*.bb ${LAYERDIR}/recipes-*/*/*.bbappend"


BBFILE_COLLECTIONS += "meta-pic64gx-bsp"
BBFILE_PATTERN_meta-pic64gx-bsp = "^${LAYERDIR}/"
BBFILE_PRIORITY_meta-pic64gx-bsp = "6"

# This should only be incremented on significant changes that will
# cause compatibility issues with other layers
LAYERVERSION_meta-pic64gx-bsp = "1"

LAYERDEPENDS_meta-pic64gx-bsp = "core"
LAYERDEPENDS_meta-pic64gx-bsp += "openembedded-layer"

LAYERSERIES_COMPAT_meta-pic64gx-bsp = "scarthgap styhead"
```

## meta-pic64gx-bsp/conf/machine/pic64gx-curiosity-kit-amp.conf
```bitbake
#@TYPE: Machine
#@NAME: pic64gx-curiosity-kit-amp
#@SOC: PIC64GX
#@DESCRIPTION: Machine configuration for the Microchip PIC64GX, Curiosity kit

require include/pic64gx-common.inc

MACHINE_TYPE = "amp"

RISCV_SBI_FDT ?=  "pic64gx-curiosity-kit.dtb"
KERNEL_DTC_FLAGS += "-@"
KERNEL_DEVICETREE ?= "microchip/${RISCV_SBI_FDT}"

UBOOT_CONFIG = "pic64gx_curiosity_kit"
UBOOT_CONFIG[pic64gx_curiosity_kit] = "microchip_pic64gx_curiosity_kit_amp_defconfig"

## Generate a boot.scr file which should be included
##  in the boot partition. It will try to load a kernel image from mmc
UBOOT_ENV = "boot"
UBOOT_ENV_SUFFIX = "scr"
UBOOT_ENV_SIZE = "0x2000"

# Name translation for zephyr related project build
ZEPHYR_BOARD = "pic64gx_curiosity_kit"
# By defining that variable, we request zephyr to use it's own toolchain
ZEPHYR_TOOLCHAIN_VARIANT = "zephyr"

## Select the YAML file used for building the HSS payload
HSS_PAYLOAD = "amp"

## Set this to "freertos" for a Linux + FreeRTOS demo or "bm" for a Linux + Bare Metal demo
# Or set it to "zephyr" for a Linux + Zephyr demo
# AMP_DEMO = "freertos"
AMP_DEMO = "zephyr"
# AMP_DEMO = "bm"

IMAGE_INSTALL:append = " pic64gx-zephyr-amp-demo"

IMAGE_BOOT_FILES ?= " \
    fitImage \
    boot.scr \
    uboot.env \
"

WKS_FILE ?= "pic64gx-rootfs.wks"
```

## meta-pic64gx-bsp/conf/machine/pic64gx-curiosity-kit-nand.conf
```bitbake
#@TYPE: Machine
#@NAME: pic64gx-curiosity-kit-nand
#@SOC: PIC64GX
#@DESCRIPTION: Machine configuration for the Microchip PIC64GX, Curiosity Kit

require include/pic64gx-common.inc

MACHINE_TYPE = "smp"

RISCV_SBI_FDT ?=  "pic64gx-curiosity-kit.dtb"
KERNEL_DTC_FLAGS += "-@"
KERNEL_DEVICETREE ?= "microchip/${RISCV_SBI_FDT}"

UBOOT_CONFIG = "pic64gx_curiosity_kit"
UBOOT_CONFIG[pic64gx_curiosity_kit] = "microchip_pic64gx_curiosity_kit_defconfig"

# UBIFS for Mikroe FLash 5 Click (128 MB)
MKUBIFS_ARGS ?= " -e 126976 -c 926 -m 2048 -x zlib -F"
UBINIZE_ARGS ?= " -m 2048 -p 128KiB -s 2048"

PIC64GX_MTDPARTS = "spi2.0:2m(payload),119m(ubi)"
PIC64GX_IS_ON_MTDID = "spi2.0"
PIC64GX_MTD_TYPE = "nand"
UBI_VOLNAME = "ubi"

IMAGE_CLASSES:append = " image_type_mtd image_type-ubimage"
IMAGE_FSTYPES = "  mtd ubifs ubimg"
UBI_ROOTFS_SIZE = "16"

UBOOT_ENV = "boot"
UBOOT_ENV_SUFFIX = "scr"
UBOOT_ENV_SIZE = "0x2000"

HSS_PAYLOAD = "uboot"

IMAGE_BOOT_FILES ?= " \
    fitImage \
    boot.scr \
"

WKS_FILE ?= "pic64gx-rootfs.wks"

MACHINEOVERRIDES =. "pic64gx-curiosity-kit:"
```

## meta-pic64gx-bsp/conf/machine/pic64gx-curiosity-kit-nor.conf
```bitbake
#@TYPE: Machine
#@NAME: pic64gx-curiosity-kit-nor
#@SOC: PIC64GX
#@DESCRIPTION: Machine configuration for the Microchip PIC64GX, Curiosity Kit

require include/pic64gx-common.inc

MACHINE_TYPE = "smp"

RISCV_SBI_FDT ?=  "pic64gx-curiosity-kit.dtb"
KERNEL_DTC_FLAGS += "-@"
KERNEL_DEVICETREE ?= "microchip/${RISCV_SBI_FDT}"

UBOOT_CONFIG = "pic64gx_curiosity_kit"
UBOOT_CONFIG[pic64gx_curiosity_kit] = "microchip_pic64gx_curiosity_kit_qspi_nor_defconfig"

# UBIFS for PMOD SF3 NOR FLash + Pmod HAT Adapter (32 MB)
MKUBIFS_ARGS ?= " -e 65408 -c 422 -m 1 -x zlib"
UBINIZE_ARGS ?= " -m 1 -p 64KiB"

PIC64GX_MTDPARTS = "spi2.0:2m(payload),28m(ubi)"
PIC64GX_IS_ON_MTDID = "spi2.0"
PIC64GX_MTD_TYPE = "nor"
UBI_VOLNAME = "ubi"

IMAGE_CLASSES:append = " image_type_mtd image_type-ubimage"
IMAGE_FSTYPES = "  mtd ubifs ubimg"
UBI_ROOTFS_SIZE = "16"

UBOOT_ENV = "boot"
UBOOT_ENV_SUFFIX = "scr"
UBOOT_ENV_SIZE = "0x2000"

HSS_PAYLOAD = "uboot"

PREFERRED_VERSION_systemd = "250.5"

IMAGE_BOOT_FILES ?= " \
    fitImage \
    boot.scr \
"

WKS_FILE ?= "pic64gx-rootfs.wks"

MACHINEOVERRIDES =. "pic64gx-curiosity-kit:"
```

## meta-pic64gx-community/conf/layer.conf
```bitbake
# We have a conf and classes directory, add to BBPATH
BBPATH .= ":${LAYERDIR}"

# We have recipes-* directories, add to BBFILES
BBFILES += "${LAYERDIR}/recipes-*/*/*.bb ${LAYERDIR}/recipes-*/*/*.bbappend"


BBFILE_COLLECTIONS += "meta-pic64gx-community"
BBFILE_PATTERN_meta-pic64gx-community = "^${LAYERDIR}/"
BBFILE_PRIORITY_meta-pic64gx-community = "6"

# This should only be incremented on significant changes that will
# cause compatibility issues with other layers
LAYERVERSION_meta-pic64gx-community = "1"

LAYERDEPENDS_meta-pic64gx-community = "meta-pic64gx-bsp"

LAYERSERIES_COMPAT_meta-pic64gx-community = "scarthgap styhead"
```

## meta-pic64gx-extras/conf/machine/pic64gx-curiosity-kit-auth.conf
```bitbake
#@TYPE: Machine
#@NAME: pic64gx-curiosity-kit
#@SOC: PIC64GX
#@DESCRIPTION: Machine configuration for the Microchip PIC64GX, Curiosity Kit

require conf/machine/include/pic64gx-common.inc

MACHINE_TYPE = "smp"

RISCV_SBI_FDT ?=  "pic64gx-curiosity-kit.dtb"
KERNEL_DTC_FLAGS += "-@"
KERNEL_DEVICETREE ?= "microchip/${RISCV_SBI_FDT}"

UBOOT_CONFIG = "pic64gx_curiosity_kit"
UBOOT_CONFIG[pic64gx_curiosity_kit] = "microchip_pic64gx_curiosity_kit_defconfig"

##UBOOT_ENV = "tftp-mmc"

HSS_PAYLOAD = "uboot"

UBOOT_SIGN_ENABLE = "1"
UBOOT_SIGN_KEYNAME ?= "pic64gx_fitimage_key"
UBOOT_SIGN_KEYDIR ?= "${TOPDIR}/../keys"
UBOOT_MKIMAGE_DTCOPTS = "-I dts -O dtb -p 2000"
FIT_SIGN_ALG = "rsa4096"
FIT_HASH_ALG = "sha256"

HSS_PAYLOAD_PRIVATE_KEYNAME ?= "x509-ec-secp384r1-private"
HSS_PAYLOAD_KEYDIR ?= "${TOPDIR}/../keys"

IMAGE_BOOT_FILES ?= " \
    fitImage \
"

WKS_FILE ?= "pic64gx-rootfs.wks"

MACHINEOVERRIDES =. "pic64gx-curiosity-kit:"
```
